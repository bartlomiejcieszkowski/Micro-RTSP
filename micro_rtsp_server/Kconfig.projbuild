## micro_rtsp_server/Kconfig.projbuild
```kconfig
menu "Micro RTSP Server Configuration"
    config MICRO_RTSP_SERVER
        bool "Enable Micro RTSP Server"
        default y
        help
            Enables Micro RTSP Server

    choice MICRO_RTSP_PORT
        bool "RTSP server port"
        default MICRO_RTSP_PORT_8554
        help
            rtsp port

        config MICRO_RTSP_PORT_8554
            bool "8554"
        config MICRO_RTSP_PORT_554
            bool "554"
    endchoice

    choice ESP32_CAMERA_CONFIG
        bool "Camera config to use"
        default ESP32_CAMERA_CONFIG_DEFAULT
        help
            Determines compiled in camera config.

        config ESP32_CAMERA_CONFIG_DEFAULT
            bool "DEFAULT"
        config ESP32_CAMERA_CONFIG_AITHINKER
            bool "AITHINKER"
        config ESP32_CAMERA_CONFIG_TTGO_T
            bool "TTGO T"
    endchoice
    
    choice ESP32_CAMERA_FRAMESIZE
        bool "Camera framesize"
        default ESP32_CAMERA_FRAMESIZE_SVGA
        help
            If the framerate is low, try lowering framesize

        config ESP32_CAMERA_FRAMESIZE_QVGA
            bool "QVGA (320x240)"
        config ESP32_CAMERA_FRAMESIZE_VGA
            bool "SVGA (640x480)"
        config ESP32_CAMERA_FRAMESIZE_SVGA
            bool "SVGA (800x600)"
        config ESP32_CAMERA_FRAMESIZE_SXGA
            bool "SXGA (1280x1024)"
        config ESP32_CAMERA_FRAMESIZE_UXGA
            bool "UXGA (1600x1200)"
    endchoice
endmenu
```
